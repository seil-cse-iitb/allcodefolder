#include <ESP8266WiFi.h>
#include <PubSubClient.h>
#include <IRremoteESP8266.h>
#include <EEPROM.h>
#include <ESP8266mDNS.h>
#include <WiFiClient.h>

int khz = 38; // 38kHz carrier frequency for both NEC and Samsung

// for esp 01 use pin 1
// for esp8266 node mcu use D2
IRsend irsend(1);

int AC_INPUT = 1; // digital input pin, active LOW logic
int AC_VAL = 0;    // variale to store status of AC_INPUT pin
int AC_STATE = 1; // initializing  ac_state variable such that when RPi code is started, it helps arduino to turn the IDUs OFF.

int ledPin = 1;
//int pirInputPin = D4;

int pirState = LOW;             // we start, assuming no motion detected
int val = 0;

//27
//3443, 1646, 510, 1225, 484, 384, 484, 410, 484, 384, 483, 384, 484,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 458


//28
//3463, 1619, 486, 1224, 536, 357, 486, 382, 486, 408, 509, 359, 485,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 279, 10000000000010000000000000000010111111011111111100000000110001110011100010010001011011101001000001101111111111000000001111010100001010111

//21
//3418, 1672, 484, 1225, 511, 383, 483, 385, 484, 384, 484, 410, 484,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 237, 10000000000010000000000000000010111111011111111100000000110001110011100010010001011011101001000001101111111111000000001110111000010001111


//22
//3417, 1669, 510, 1225, 484, 384, 483, 385, 510, 384, 483, 384, 484,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 458, 1000000000001000000000000000001011111101111111110000000011000111001110001001000101101110100100000110111111111100000000111111100000000111


//23
//3416, 1668, 484, 1226, 509, 384, 460, 408, 460, 408, 511, 382, 461,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 484, 1000000000001000000000000000001011111101111111110000000011000111001110001001000101101110100100000110111111111100000000111000010001111011


//24
//3418, 1670, 508, 1227, 484, 384, 460, 434, 484, 383, 483, 385, 483,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 458, 1000000000001000000000000000001011111101111111110000000011000111001110001001000101101110100100000110111111111100000000111100010000111011


//25
//3445, 1645, 483, 1226, 510, 384, 460, 408, 460, 433, 484, 384, 460,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 483, 1000000000001000000000000000001011111101111111110000000011000111001110001001000101101110100100000110111111111100000000111010010001011011


//26
//3438, 1647, 484, 1252, 484, 383, 484, 384, 511, 383, 483, 385, 484,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 458, 1000000000001000000000000000001011111101111111110000000011000111001110001001000101101110100100000110111111111100000000111110010000011011





//27 on
unsigned  Signal_ON_27[] = {3446, 1673, 484, 1225, 483, 385, 483, 410, 484, 384, 484, 384, 483,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 104014, 279};

//28 ON
unsigned  Signal_ON_28[] = {3443, 1647, 509, 1226, 460, 407, 484, 410, 483, 385, 460, 408, 460,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 385, 434};


//26 ON
unsigned  Signal_ON_26[] = {392, 289600, 257, 203772, 230, 541070, 3443, 1645, 459, 1276, 460, 408, 460,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 924646, 222};

//25 ON
unsigned  int Signal_ON_25[] = {248, 807472, 3418, 1671, 485, 1224, 511, 383, 484, 384, 485, 383, 485,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 383, 485};


//24 ON
unsigned  Signal_ON_24[] = {257, 1649187, 3445, 1644, 484, 1226, 508, 385, 484, 384, 484, 384, 512,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 408, 460};

//23 ON
unsigned  Signal_ON_23[] = {3413, 1672, 483, 1226, 460, 434, 485, 383, 460, 407, 484, 410, 485,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 385, 460};

//22 ON
unsigned  Signal_ON_22[] = {3445, 1644, 484, 1226, 536, 357, 461, 407, 460, 408, 511, 382, 461,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 408, 460};


//21 ON
unsigned  Signal_ON_21[] = {3421, 1671, 485, 1224, 511, 383, 484, 384, 485, 382, 486, 408, 486,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 408, 460};






MDNSResponder mdns;
WiFiServer server(80);

const char* ssid = "BUBBLES";
const char* password = "";
String st;

//// Hitachi VRF - SEIL Lab
//unsigned int Signal_ON[] = {3488, 1584, 548, 1184, 520, 348, 520, 348, 544, 348, 520, 344, 524,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 320, 548};
unsigned int Signal_OFF[] = {3488, 1608, 544, 1160, 524, 372, 544, 320, 548, 320, 520, 372, 520,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 320, 544};

//on
unsigned  Signal_ON[] ={3439, 1646, 510, 1225, 485, 383, 485, 382, 510, 384, 510, 358, 486,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 1199, 509};
//unsigned Signal_OFF[] ={8950,4350,750,1550,700,500,700,500,700,450,750,450,750,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500,700};






void turn_on_AC()
{
  Serial.println("Turning ON");
  irsend.sendRaw(Signal_ON, sizeof(Signal_ON) / sizeof(int), khz); // Sends ON code
}

void turn_off_AC()
{
  Serial.println("Turning OFF");
  irsend.sendRaw(Signal_OFF, sizeof(Signal_OFF) / sizeof(int), khz); // Sends OFF Code
}



// Update these with values suitable for your network.

const char* mqtt_server = "m12.cloudmqtt.com";


WiFiClient espClient;
PubSubClient client(espClient);
long lastMsg = 0;
char msg[50];
int value = 0;

void setup_wifi() {
   delay(100);
  // We start by connecting to a WiFi network
    Serial.print("Connecting to ");
    Serial.println(ssid);
    WiFi.begin(ssid, password);
    while (WiFi.status() != WL_CONNECTED)
    {

      wifiConnectBlink();
      Serial.print(".");
    }
  randomSeed(micros());
  Serial.println("");
  Serial.println("WiFi connected");
  Serial.println("IP address: ");
  Serial.println(WiFi.localIP());



}

void callback(char* topic, byte* payload, unsigned int length)
{
  Serial.print("Command is : [");
  Serial.print(topic);
  int p =(char)payload[0]-'0';
  int p1 =(char)payload[1]-'0';
  int val = p*10+p1;

Serial.print(p);
  digitalWrite(LED_BUILTIN, HIGH);
  delay(800);
  digitalWrite(LED_BUILTIN, LOW);
switch (val) {
    case 21:
        Serial.println("Turning ON at 21");
        irsend.sendRaw(Signal_ON_21, sizeof(Signal_ON_21) / sizeof(int), khz); // Sends ON code;
        Serial.println("Turning ON");
      break;
    case 22:
        Serial.println("Turning ON at 22");
        irsend.sendRaw(Signal_ON_22, sizeof(Signal_ON_22) / sizeof(int), khz); // Sends ON code
        Serial.println("Turning ON");
      break;
    case 23:
        Serial.println("Turning ON at 23");
        irsend.sendRaw(Signal_ON_23, sizeof(Signal_ON_23) / sizeof(int), khz); // Sends ON code
        Serial.println("Turning ON");
      break;
    case 24:
        Serial.println("Turning ON at 24");
        irsend.sendRaw(Signal_ON_24, sizeof(Signal_ON_24) / sizeof(int), khz); // Sends ON code
        Serial.println("Turning ON");
      break;
    case 25:
        Serial.println("Turning ON at 25");
        irsend.sendRaw(Signal_ON_25, sizeof(Signal_ON_25) / sizeof(int), khz); // Sends ON code
        Serial.println("Turning ON");
      break;
    case 26:
        Serial.println("Turning ON at 26");
        irsend.sendRaw(Signal_ON_26, sizeof(Signal_ON_26) / sizeof(int), khz); // Sends ON code
        Serial.println("Turning ON");
      break;
    case 27:
        Serial.println("Turning ON at 27");
        irsend.sendRaw(Signal_ON_27, sizeof(Signal_ON_27) / sizeof(int), khz); // Sends ON code
        Serial.println("Turning ON");
      break;
    case 28:
        Serial.println("Turning ON at 28");
        irsend.sendRaw(Signal_ON_28, sizeof(Signal_ON_28) / sizeof(int), khz); // Sends ON code
        Serial.println("Turning ON");
      break;
    case 0:
        Serial.println("Turning OFF");
        irsend.sendRaw(Signal_OFF, sizeof(Signal_OFF) / sizeof(int), khz); // Sends ON code
        Serial.println("Turning OFF");
      break;
    default:
      // if nothing else matches, do the default
      // default is optional
    break;
  }
}

void reconnect() {
  // Loop until we're reconnected

if(WiFi.status() != WL_CONNECTED) {
        WiFi.begin(ssid, password);
    while (WiFi.status() != WL_CONNECTED)
    {
      wifiConnectBlink();
      Serial.print(".");
    }


  }

  while (!client.connected())
  {
    Serial.print("Attempting MQTT connection...");
    // Create a random client ID
    String clientId = "ESP8266Client-";
    clientId += String(random(0xffff), HEX);
    // Attempt to connect
    //if you MQTT broker has clientID,username and password
    //please change following line to    if (client.connect(clientId,userName,passWord))
    if (client.connect(clientId.c_str(),"uyjzyogt","dZg-yLbxqqcW"))
    {
      Serial.println("connected");
     //once connected to MQTT broker, subscribe command if any
      client.subscribe("testaccontrol");
    } else {
      Serial.print("failed, rc=");
      Serial.print(client.state());
      Serial.println(" try again in 5 seconds");
      // Wait 6 seconds before retrying
      delay(6000);
    }
  }
} //end reconnect()

void setup() {

  Serial.begin(9600);
//  pinMode(pirInputPin, INPUT);
  pinMode(ledPin, OUTPUT);
  digitalWrite(ledPin, LOW);
//  setup_wifi();
connectToWifi();


  irsend.begin();


  //WiFiServer server(80);

  delay(10);





}



void connectToWifi(){



     EEPROM.begin(512);
  delay(10);
  Serial.println();
  Serial.println();
  Serial.println("Startup");
  // read eeprom for ssid and pass
  Serial.println("Reading EEPROM ssid");
  String esid;
  for (int i = 0; i < 32; ++i)
    {
      esid += char(EEPROM.read(i));
    }
  Serial.print("SSID: ");
  Serial.println(esid);
  Serial.println("Reading EEPROM pass");
  String epass = "";
  for (int i = 32; i < 96; ++i)
    {
      epass += char(EEPROM.read(i));
    }
    password = epass.c_str();
  Serial.print("PASS: ");
  Serial.println(epass);
  if ( esid.length() > 1 ) {
      // test esid
      WiFi.begin(esid.c_str(), epass.c_str());
      if ( testWifi() == 20 ) {
//          launchWeb(0);
            Serial.println("connected to wifi");
            client.setServer(mqtt_server, 12296);
            client.setCallback(callback);
            return;
      }
  }
    //if wifi details not present in memory
     setupAP();



  }

int testWifi(void) {
  int c = 0;
  Serial.println("Waiting for Wifi to connect");
  while ( c < 20 ) {
    if (WiFi.status() == WL_CONNECTED) {
        Serial.println("");
  Serial.println("WiFi connected");
  Serial.println("IP address: ");
  Serial.println(WiFi.localIP());
  return(20);
  }
    wifiConnectBlink();
    c++;
    Serial.println(c);
  }
  Serial.println("Connect timed out, opening AP");
  return(10);
}


void launchWeb(int webtype) {
          Serial.println("");
          Serial.println("WiFi connected");
          Serial.println(WiFi.localIP());
          Serial.println(WiFi.softAPIP());
          if (!mdns.begin("esp8266", WiFi.localIP())) {
            Serial.println("Error setting up MDNS responder!");
            while(1) {
              delay(1000);
            }
          }
          Serial.println("mDNS responder started");
          // Start the server
          server.begin();
          Serial.println("Server started");
          int b = 20;
          int c = 0;
          while(b == 20) {
             b = mdns1(webtype);
           }
}


void setupAP(void) {

  WiFi.mode(WIFI_STA);
  WiFi.disconnect();
  delay(100);
  int n = WiFi.scanNetworks();
  Serial.println("scan done");
  if (n == 0)
    Serial.println("no networks found");
  else
  {
    Serial.print(n);
    Serial.println(" networks found");
    for (int i = 0; i < n; ++i)
     {
      // Print SSID and RSSI for each network found
      Serial.print(i + 1);
      Serial.print(": ");
      Serial.print(WiFi.SSID(i));
      Serial.print(" (");
      Serial.print(WiFi.RSSI(i));
      Serial.print(")");
      Serial.println((WiFi.encryptionType(i) == ENC_TYPE_NONE)?" ":"*");
      delay(10);
     }
  }
  Serial.println("");
  st = "<ul>";
  for (int i = 0; i < n; ++i)
    {
      // Print SSID and RSSI for each network found
      st += "<li>";
      st +=i + 1;
      st += ": ";
      st += WiFi.SSID(i);
      st += " (";
      st += WiFi.RSSI(i);
      st += ")";
      st += (WiFi.encryptionType(i) == ENC_TYPE_NONE)?" ":"*";
      st += "</li>";
    }
  st += "</ul>";
  delay(100);
  WiFi.mode(WIFI_AP);
  WiFi.softAP(ssid);
  Serial.println("softap");
  Serial.println("");
  launchWeb(1);
  Serial.println("over");
}



int mdns1(int webtype)
{
  // Check for any mDNS queries and send responses
  mdns.update();

  // Check if a client has connected
  WiFiClient client = server.available();
  if (!client) {
    return(20);
  }
  Serial.println("");
  Serial.println("New client");

  // Wait for data from client to become available
  while(client.connected() && !client.available()){
    delay(1);
   }

  // Read the first line of HTTP request
  String req = client.readStringUntil('\r');

  // First line of HTTP request looks like "GET /path HTTP/1.1"
  // Retrieve the "/path" part by finding the spaces
  int addr_start = req.indexOf(' ');
  int addr_end = req.indexOf(' ', addr_start + 1);
  if (addr_start == -1 || addr_end == -1) {
    Serial.print("Invalid request: ");
    Serial.println(req);
    return(20);
   }
  req = req.substring(addr_start + 1, addr_end);
  Serial.print("Request: ");
  Serial.println(req);
  client.flush();
  String s;
  if ( webtype == 1 ) {
      if (req == "/")
      {
        IPAddress ip = WiFi.softAPIP();
        String ipStr = String(ip[0]) + '.' + String(ip[1]) + '.' + String(ip[2]) + '.' + String(ip[3]);
        s = "HTTP/1.1 200 OK\r\nContent-Type: text/html\r\n\r\n<!DOCTYPE HTML>\r\n<html>Hello from ESP8266 at ";
        s += ipStr;
        s += "<p>";
        s += st;
        s += "<form method='get' action='a'><label>SSID: </label><input name='ssid' length=32><input name='pass' length=64><input type='submit'></form>";
        s += "</html>\r\n\r\n";
        Serial.println("Sending 200");
      }
      else if ( req.startsWith("/a?ssid=") ) {

        Serial.println("clearing eeprom");
        for (int i = 0; i < 96; ++i) { EEPROM.write(i, 0); }
        String qsid;
        qsid = req.substring(8,req.indexOf('&'));
        Serial.println(qsid);
        Serial.println("");
        String qpass;
        qpass = req.substring(req.lastIndexOf('=')+1);
        Serial.println(qpass);
        Serial.println("");

        Serial.println("writing eeprom ssid:");
        for (int i = 0; i < qsid.length(); ++i)
          {
            EEPROM.write(i, qsid[i]);
            Serial.print("Wrote: ");
            Serial.println(qsid[i]);
          }
        Serial.println("writing eeprom pass:");
        for (int i = 0; i < qpass.length(); ++i)
          {
            EEPROM.write(32+i, qpass[i]);
            Serial.print("Wrote: ");
            Serial.println(qpass[i]);
          }
        EEPROM.commit();
        s = "HTTP/1.1 200 OK\r\nContent-Type: text/html\r\n\r\n<!DOCTYPE HTML>\r\n<html>Hello from ESP8266 ";
        s += "Found ";
        s += req;
        s += "<p> saved to eeprom... reset to boot into new wifi</html>\r\n\r\n";
      }
      else
      {
        s = "HTTP/1.1 404 Not Found\r\n\r\n";
        Serial.println("Sending 404");
      }
  }
  else
  {
      if (req == "/")
      {
        s = "HTTP/1.1 200 OK\r\nContent-Type: text/html\r\n\r\n<!DOCTYPE HTML>\r\n<html>Hello from ESP8266";
        s += "<p>";
        s += "</html>\r\n\r\n";
        Serial.println("Sending 200");
      }
      else if ( req.startsWith("/cleareeprom") ) {
        s = "HTTP/1.1 200 OK\r\nContent-Type: text/html\r\n\r\n<!DOCTYPE HTML>\r\n<html>Hello from ESP8266";
        s += "<p>Clearing the EEPROM<p>";
        s += "</html>\r\n\r\n";
        Serial.println("Sending 200");
        Serial.println("clearing eeprom");
        for (int i = 0; i < 96; ++i) { EEPROM.write(i, 0); }
        EEPROM.commit();
      }
      else
      {
        s = "HTTP/1.1 404 Not Found\r\n\r\n";
        Serial.println("Sending 404");
      }
  }
  client.print(s);
  Serial.println("Done with client");
  return(20);
}


void wifiConnectBlink(){

  digitalWrite(ledPin, HIGH);
  delay(500);
  Serial.println("connecting to wifi");
  digitalWrite(ledPin, LOW);
  delay(500);


  }


void mqttConnectBlink(){
  digitalWrite(ledPin, HIGH);
  delay(1000);
  digitalWrite(ledPin, LOW);
  delay(500);

  }

void loop() {



}
